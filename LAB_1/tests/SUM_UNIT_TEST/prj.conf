## CMakeLists.txt
```
cmake_minimum_required(VERSION 3.20.0)

find_package(Zephyr REQUIRED HINTS $ENV{ZEPHYR_BASE})
project(sum_unit_test)

target_sources(app PRIVATE
    src/sum_test.c
    ../../sum_log/sum_log.c
)

target_include_directories(app PRIVATE
    ../../sum_log
)
```

## prj.conf
```kconfig
CONFIG_ZTEST=y
CONFIG_ZTEST_ASSERT_VERBOSE=2

CONFIG_LOG=y
CONFIG_LOG_DEFAULT_LEVEL=3
```

## src/sum_test.c
```c
#include <zephyr/ztest.h>

#include "sum_log.h"

ZTEST(sum_log_test_suite, test_sum_log_basic)
{
	int result = sum_log(2, 3);

	zassert_equal(result, 5, "Expected 2 + 3 to equal 5");
}

ZTEST(sum_log_test_suite, test_sum_log_negative)
{
	int result = sum_log(-8, 3);

	zassert_equal(result, -5, "Expected -8 + 3 to equal -5");
}

ZTEST(sum_log_test_suite, test_sum_log_zero)
{
	int result = sum_log(0, 0);

	zassert_equal(result, 0, "Expected 0 + 0 to equal 0");
}

ZTEST_SUITE(sum_log_test_suite, NULL, NULL, NULL, NULL, NULL);
```
